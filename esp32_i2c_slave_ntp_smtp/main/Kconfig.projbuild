## esp32_i2c_slave_ntp_smtp/main/Kconfig.projbuild
```kconfig
menu "Example Configuration"

    config SMTP_SERVER
        string "Mail Server"
        default "smtp.googlemail.com"
        help
            Target domain for the example to connect to.

    config SMTP_PORT_NUMBER
        string "Mail port number"
        default "587"
        help
            Mail port number for the example to connect to.

    config SMTP_SENDER_MAIL
        string "Sender email"
        default "sender.email@gmail.com"
        help
            Sender's Email address

    config SMTP_SENDER_PASSWORD
        string "Sender password"
        default "password@123"
        help
            Sender's email password

    config SMTP_RECIPIENT_MAIL
        string "Recipient email"
        default "recipient.email@gmail.com"
        help
            Recipient's email

endmenu

menu "SNTP Configuration"

    choice SNTP_TIME_SYNC_METHOD
        prompt "Time synchronization method"
        default SNTP_TIME_SYNC_METHOD_IMMED
        help
            Time synchronization method.

        config SNTP_TIME_SYNC_METHOD_IMMED
            bool "update time immediately when received"
        config SNTP_TIME_SYNC_METHOD_SMOOTH
            bool "update time with smooth method (adjtime)"
        config SNTP_TIME_SYNC_METHOD_CUSTOM
            bool "custom implementation"
    endchoice

endmenu

menu "I2C Slave"
    config I2C_SLAVE_SCL
        int "SCL GPIO Num"
        default 5
        help
            GPIO number for I2C Slave clock line.

    config I2C_SLAVE_SDA
        int "SDA GPIO Num"
        default 4
        help
            GPIO number for I2C Slave data line.

    config I2C_SLAVE_PORT_NUM
        int "Port Number"
        default 0
        help
            Port number for I2C Slave device.

    config I2C_SLAVE_ADDRESS
        hex "ESP Slave Address"
        default 0x28
        help
            Hardware Address of I2C Slave Port.
endmenu
```
